## boards/HarryL/debug_flpr_ipc/Kconfig.debug_flpr_ipc
```kconfig
config BOARD_DEBUG_FLPR_IPC
	select SOC_NRF54L15_CPUAPP if BOARD_DEBUG_FLPR_IPC_NRF54L15_CPUAPP
	select SOC_NRF54L15_CPUFLPR if \
		BOARD_DEBUG_FLPR_IPC_NRF54L15_CPUFLPR
```

## boards/HarryL/debug_flpr_ipc/board.yml
```yaml
board:
  name: debug_flpr_ipc
  full_name: debug_flpr_ipc
  vendor: HarryL
  socs:
  - name: nrf54l15
    variants:
    - name: xip
      cpucluster: cpuflpr
```
