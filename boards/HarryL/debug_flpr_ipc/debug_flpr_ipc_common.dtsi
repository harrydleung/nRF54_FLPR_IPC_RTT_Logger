#include "debug_flpr_ipc-pinctrl.dtsi"

&uart30 {
	current-speed = <115200>;
	pinctrl-0 = <&uart30_default>;
	pinctrl-1 = <&uart30_sleep>;
	pinctrl-names = "default", "sleep";
	status = "disabled";
};
